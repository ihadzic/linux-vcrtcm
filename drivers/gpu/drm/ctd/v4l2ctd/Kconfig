## drivers/gpu/drm/ctd/v4l2ctd/Kconfig
```kconfig
config DRM_VCRTCM_CTD_V4L2CTD
	tristate "Video for Linux CTD Driver"
	depends on DRM_VCRTCM && VIDEO_V4L2
	help
	 CTD Driver for V4L2. Attaches to a Virtual CTRC
	 and presents the pixel flow from GPU as a
	 V4L2 device to the user space. Allows applications
	 that can take the V4L2 input to do something good
	 with rendered pixels

	 select 'm' or 'n'; 'y' not tested yet
```

## drivers/gpu/drm/pcon/udl/Kconfig
```kconfig
config DRM_VCRTCM_PCON_UDL
	tristate "DisplayLink USB Graphics Adapter PCON"
	depends on DRM_VCRTCM && FB && USB
	select FB_MODE_HELPERS
	help
	 PCON for DisplayLink USB Graphics Adapter.
	 Attaches to a Virtual CRTC and displays rendered
	 pixels on a DisplayLink device. In other words,
	 lets your GPU do the hardware-accelerated
	 rendering and display the output on a DisplayLink
	 monitor.

	 select 'm' or 'n'; 'y' not tested yet
```

## drivers/gpu/drm/pcon/v4l2/Kconfig
```kconfig
config DRM_VCRTCM_PCON_V4L2
	tristate "Video for Linux PCON"
	depends on DRM_VCRTCM && VIDEO_V4L2
	help
	 PCON for V4L2. Attaches to a Virtual CTRC
	 and presents the pixel flow from GPU as a
	 V4L2 device to the user space. Allows applications
	 that can take the V4L2 input to do something good
	 with rendered pixels

	 select 'm' or 'n'; 'y' not tested yet
```

## drivers/gpu/drm/pim/udl/Kconfig
```kconfig
config DRM_VCRTCM_PIM_UDL
	tristate "DisplayLink USB Graphics Adapter PIM"
	depends on DRM_VCRTCM && FB && USB
	select FB_MODE_HELPERS
	help
	 PIM for DisplayLink USB Graphics Adapter.
	 Instantiated PCONs send their pixel stream to a
	 DisplayLink device.  Lets your GPU do the hardware-
	 accelerated rendering and display the output on a
	 DisplayLink monitor.

	 select 'm' or 'n'; 'y' not tested yet
```

## drivers/gpu/drm/pim/v4l2/Kconfig
```kconfig
config DRM_VCRTCM_PIM_V4L2
	tristate "Video for Linux PIM"
	depends on DRM_VCRTCM && VIDEO_V4L2
	help
	 PIM for V4L2.  Instantiated PCONs present their pixel
	 stream as a V4L2 device in user space. Allows applications
	 that can take V4L2 input to do something good with the
	 rendered pixels

	 select 'm' or 'n'; 'y' not tested yet
```
